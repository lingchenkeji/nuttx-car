## apps/myprojects/modules/cdc_svc/Kconfig
```kconfig
#
# CDC JSON service module
#

config MYPROJECTS_MODULES_CDC_SVC
  bool "CDC JSON Service Module"
  default y
  depends on MYPROJECTS_MODULES_PARAM
  ---help---
    Enable JSON command service used by host over CDC-ACM.

if MYPROJECTS_MODULES_CDC_SVC

config MYPROJECTS_MODULES_CDC_SVC_NSH
  bool "CDC JSON NSH command (p1ctl)"
  default y
  depends on NSH_LIBRARY
  ---help---
    Enable p1ctl command to send one JSON request and print one JSON response.

endif # MYPROJECTS_MODULES_CDC_SVC
```

## apps/myprojects/modules/func_led/Kconfig
```kconfig
#
# Functional LED Module Configuration
#

config MYPROJECTS_MODULES_FUNC_LED
	bool "Functional LED Module"
	default n
	depends on ARCH_CHIP_STM32
	---help---
		Enable the functional LED driver module.

		This module controls an external 5V LED driven by S8050 NPN
		transistor via GPIO (active-high). Provides on/off/toggle/blink
		and timed-on functionality for integration with other modules
		(e.g. RFID notification).

if MYPROJECTS_MODULES_FUNC_LED

config MYPROJECTS_MODULES_FUNC_LED_NSH
	bool "Functional LED NSH Command"
	default y
	depends on NSH_LIBRARY
	---help---
		Enable the func_led NSH command for testing and debugging.

endif # MYPROJECTS_MODULES_FUNC_LED
```

## apps/myprojects/modules/motor_drv/Kconfig
```kconfig
#
# DRV8212 Motor Driver Module Configuration
#

config MYPROJECTS_MODULES_MOTOR_DRV
	bool "Motor Driver Module (DRV8212)"
	default n
	depends on ARCH_CHIP_STM32
	---help---
		Enable the DRV8212 motor driver module.

		This module provides basic forward/reverse/brake/coast control
		for a DC motor via DRV8212 H-bridge pins.

if MYPROJECTS_MODULES_MOTOR_DRV

config MYPROJECTS_MODULES_MOTOR_DRV_NSH
	bool "DRV8212 NSH Command"
	default y
	depends on NSH_LIBRARY
	---help---
		Enable the DRV8212 NSH command for testing and debugging.

endif # MYPROJECTS_MODULES_MOTOR_DRV
```

## apps/myprojects/modules/param/Kconfig
```kconfig
#
# Parameter persistence module
#

config MYPROJECTS_MODULES_PARAM
  bool "Parameter Module (Flash persistent)"
  default y
  depends on ARCH_HAVE_PROGMEM
  ---help---
    Enable persistent parameter storage in internal flash.
```

## apps/myprojects/modules/rfid/Kconfig
```kconfig
#
# RFID Module Configuration
#

config MYPROJECTS_MODULES_RFID
	bool "RFID Module"
	default n
	depends on SPI
	---help---
		Enable the RFID module for contactless card reading.

		This module provides RFID card reading functionality using
		ISO/IEC 14443 Type A compatible reader ICs via SPI interface.

if MYPROJECTS_MODULES_RFID

choice
	prompt "RFID Chip Selection"
	default MYPROJECTS_MODULES_RFID_CV520

config MYPROJECTS_MODULES_RFID_MFRC522
	bool "MFRC522/MFRC522B"
	---help---
		Use NXP MFRC522 or MFRC522B reader IC.

config MYPROJECTS_MODULES_RFID_CV520
	bool "CV520"
	---help---
		Use CV520 contactless reader IC.
		CV520 is register-compatible with MFRC522 and supports
		ISO/IEC 14443 Type A and MIFARE protocols via SPI.
		Supports up to 848kbit/s data transfer rate.

endchoice

config MYPROJECTS_MODULES_RFID_NSH
	bool "RFID NSH Command"
	default y
	depends on NSH_LIBRARY
	---help---
		Enable the RFID NSH command for testing and debugging.

endif # MYPROJECTS_MODULES_RFID
```

## apps/myprojects/modules/vtx/Kconfig
```kconfig
#
# VTX316 Voice Synthesis Module Configuration
#

config MYPROJECTS_MODULES_VTX
	bool "VTX316 Voice Synthesis Module"
	default n
	depends on STM32_USART1
	---help---
		Enable the VTX316 Chinese voice synthesis module.

		This module provides TTS (Text-to-Speech) functionality using the
		VTX316 voice synthesis chip via UART interface (USART1).

if MYPROJECTS_MODULES_VTX

config MYPROJECTS_MODULES_VTX_NSH
	bool "VTX316 NSH Command"
	default y
	depends on NSH_LIBRARY
	---help---
		Enable the VTX NSH command for testing and debugging.

endif # MYPROJECTS_MODULES_VTX
```

## apps/myprojects/modules/waypoint/Kconfig
```kconfig
#
# Waypoint (point-of-interest) module
#

config MYPROJECTS_MODULES_WAYPOINT
  bool "Waypoint Module (per-point LED/announce/speed)"
  default y
  depends on ARCH_HAVE_PROGMEM
  ---help---
    Enable the waypoint table: match RFID card content against up to 40
    configurable points and apply per-point LED, announce and speed
    actions.  The table is stored in dedicated flash pages.
```

## apps/myprojects/modules/ws2812/Kconfig
```kconfig
#
# WS2812B RGB LED Module Configuration
#

config MYPROJECTS_MODULES_WS2812
	bool "WS2812B RGB LED Module"
	default n
	depends on ARCH_CHIP_STM32
	---help---
		Enable the WS2812B RGB LED driver module.

		This module provides bit-banging control for WS2812B
		addressable RGB LEDs via GPIO.

if MYPROJECTS_MODULES_WS2812

config MYPROJECTS_MODULES_WS2812_NSH
	bool "WS2812 NSH Command"
	default n
	depends on NSH_LIBRARY
	---help---
		Enable the WS2812 NSH command for testing and debugging.

endif # MYPROJECTS_MODULES_WS2812
```
